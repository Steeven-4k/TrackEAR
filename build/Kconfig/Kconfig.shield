## build/Kconfig/Kconfig.shield
```kconfig
osource "C:/ncs/v2.9.0/nrf/samples/bluetooth/nrf_dm/boards/shields/*/Kconfig.shield"
osource "C:/ncs/v2.9.0/nrf/boards/shields/*/Kconfig.shield"
```

## build/nrf_dm/Kconfig/Kconfig.shield.defconfig
```kconfig
osource "C:/ncs/v2.9.0/nrf/samples/bluetooth/nrf_dm/boards/shields/*/Kconfig.defconfig"
osource "C:/ncs/v2.9.0/nrf/boards/shields/*/Kconfig.defconfig"
```
