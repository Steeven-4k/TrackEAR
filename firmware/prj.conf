## CMakeLists.txt
```
#
# Copyright (c) 2021 Nordic Semiconductor
#
# SPDX-License-Identifier: LicenseRef-Nordic-5-Clause
#
cmake_minimum_required(VERSION 3.20)

find_package(Zephyr REQUIRED HINTS $ENV{ZEPHYR_BASE})
project(nrf_dm)

# NORDIC SDK APP START
target_sources(app PRIVATE
  src/main.c
  src/pwm_led.c
  src/peer.c
  src/service.c
  src/projectPrint.c
  src/distance_measurement_handling.c
  )
# NORDIC SDK APP END

zephyr_library_include_directories(${CMAKE_CURRENT_SOURCE_DIR})
```

## prj.conf
```kconfig
#
# Copyright (c) 2021 Nordic Semiconductor ASA
#
# SPDX-License-Identifier: LicenseRef-Nordic-5-Clause
#

# BT
CONFIG_BT=y

CONFIG_BT_CENTRAL=y
CONFIG_BT_PERIPHERAL=y

CONFIG_BT_SCAN=y
CONFIG_BT_SCAN_FILTER_ENABLE=y
CONFIG_BT_SCAN_NAME_CNT=1
CONFIG_BT_SCAN_MANUFACTURER_DATA_CNT=1
CONFIG_BT_SCAN_WITH_IDENTITY=y
CONFIG_BT_ID_MAX=1
CONFIG_BT_EXT_ADV=y

CONFIG_BT_DEVICE_NAME="nRF_DM"
CONFIG_BT_DDFS=y

# Distance Measurement
CONFIG_DM_MODULE=y

CONFIG_MPSL=y
CONFIG_MPSL_TIMESLOT_SESSION_COUNT=1

CONFIG_DM_MODULE_LOG_LEVEL_DBG=n
CONFIG_DM_GPIO_DEBUG=y
CONFIG_PWM=y

CONFIG_NCS_SAMPLES_DEFAULTS=y
CONFIG_DK_LIBRARY=y

CONFIG_DM_HIGH_PRECISION_CALC=n
```

## src/main.c
```c
/*
 * Copyright (c) 2021 Nordic Semiconductor ASA
 *
 * SPDX-License-Identifier: LicenseRef-Nordic-5-Clause
 */

/** @file
 *  @brief Nordic Distance Measurement sample
 */

#include <stdint.h>
#include <zephyr/kernel.h>
#include <zephyr/sys/printk.h>
#include <zephyr/sys/byteorder.h>

#include <zephyr/bluetooth/bluetooth.h>
#include <bluetooth/scan.h>
#include <bluetooth/services/ddfs.h>

#include <dk_buttons_and_leds.h>

#include <dm.h>
#include "peer.h"
#include "service.h"

#include <zephyr/drivers/gpio.h>
#include <zephyr/sys/util.h>

#include "projectPrint.h"
#include "distance_measurement_handling.h"

//#define _IS_MASTER_
#ifdef _IS_MASTER_
	#define DEVICE_NAME             "master"
#else
	#define DEVICE_NAME             "slave"
#endif

#define DEVICE_ROLE				DM_ROLE_INITIATOR
#define OTHER_DEVICE_ROLE		DM_ROLE_REFLECTOR

#define DEVICE_NAME_LEN         (sizeof(DEVICE_NAME) - 1)

#define RUN_STATUS_LED          DK_LED2
#define CON_STATUS_LED          DK_LED3
#define RUN_LED_BLINK_INTERVAL  1000

#define SUPPORT_DM_CODE         0xFF55AA5A

#define RNG_SEED 				0xECE
bool is_lost = false;
double lf_distance = 0;

struct adv_mfg_data {
	uint16_t company_code;	    /* Company Identifier Code. */
	uint32_t support_dm_code;   /* To identify the device that supports distance measurement. */
	uint32_t rng_seed;          /* Random seed used for generating hopping patterns. */
} __packed;

static struct adv_mfg_data mfg_data;
struct bt_le_adv_param adv_param_conn =
	BT_LE_ADV_PARAM_INIT(BT_LE_ADV_OPT_CONNECTABLE |
			     BT_LE_ADV_OPT_NOTIFY_SCAN_REQ,
			     BT_GAP_ADV_FAST_INT_MIN_2,
			     BT_GAP_ADV_FAST_INT_MAX_2,
			     NULL);

struct bt_le_adv_param adv_param_noconn =
	BT_LE_ADV_PARAM_INIT(BT_LE_ADV_OPT_USE_IDENTITY |
			     BT_LE_ADV_OPT_SCANNABLE |
			     BT_LE_ADV_OPT_NOTIFY_SCAN_REQ,
			     BT_GAP_ADV_FAST_INT_MIN_2,
			     BT_GAP_ADV_FAST_INT_MAX_2,
			     NULL);

struct bt_le_adv_param *adv_param = &adv_param_conn;

/* Custom Service UUID */
#define BT_UUID_TRACKEAR_SERVICE_VAL BT_UUID_128_ENCODE(0x12345678, 0x1234, 0x5678, 0x1234, 0x56789abcdef0)
#define BT_UUID_TRACKEAR_SERVICE BT_UUID_DECLARE_128(BT_UUID_TRACKEAR_SERVICE_VAL)

/* custom Characteristic UUID */
#define BT_UUID_TRACKEAR_CHAR_LOST_VAL BT_UUID_128_ENCODE (0x12345678, 0x1234, 0x5678, 0x1234, 0x56789abcdef1)
#define BT_UUID_TRACKEAR_CHAR_LOST BT_UUID_DECLARE_128(BT_UUID_TRACKEAR_CHAR_LOST_VAL)

/* custom Characteristic UUID */
#define BT_UUID_TRACKEAR_CHAR_DIST_VAL BT_UUID_128_ENCODE (0x12345678, 0x1234, 0x5678, 0x1234, 0x56789abcdef2)
#define BT_UUID_TRACKEAR_CHAR_DIST BT_UUID_DECLARE_128(BT_UUID_TRACKEAR_CHAR_DIST_VAL)

/* GATT Service Declaration */
static ssize_t read_is_lost_char(struct bt_conn *conn,
                                 const struct bt_gatt_attr *attr,
                                 void *buf, uint16_t len, uint16_t offset);
static ssize_t read_dist_char(struct bt_conn *conn,
                                 const struct bt_gatt_attr *attr,
                                 void *buf, uint16_t len, uint16_t offset);

static const struct bt_data ad[] = {
	BT_DATA_BYTES(BT_DATA_FLAGS, (BT_LE_AD_GENERAL | BT_LE_AD_NO_BREDR)),
	BT_DATA(BT_DATA_NAME_COMPLETE, DEVICE_NAME, DEVICE_NAME_LEN),
#ifdef _IS_MASTER_
	BT_DATA_BYTES(BT_DATA_UUID128_ALL,BT_UUID_TRACKEAR_SERVICE_VAL),
#endif
};

static const struct bt_data sd[] = {
	BT_DATA(BT_DATA_MANUFACTURER_DATA, (unsigned char *)&mfg_data, sizeof(mfg_data)),
	BT_DATA_BYTES(BT_DATA_UUID128_ALL, BT_UUID_DDFS_VAL),
};

BT_GATT_SERVICE_DEFINE(track_ear,
	BT_GATT_PRIMARY_SERVICE(BT_UUID_TRACKEAR_SERVICE),
	BT_GATT_CHARACTERISTIC(BT_UUID_TRACKEAR_CHAR_LOST, BT_GATT_CHRC_READ, BT_GATT_PERM_READ, read_is_lost_char, NULL, NULL),
	BT_GATT_CHARACTERISTIC(BT_UUID_TRACKEAR_CHAR_DIST, BT_GATT_CHRC_READ, BT_GATT_PERM_READ, read_dist_char, NULL, NULL),
);

/* GATT Service Declaration */
static ssize_t read_is_lost_char(struct bt_conn *conn,
                                 const struct bt_gatt_attr *attr,
                                 void *buf, uint16_t len, uint16_t offset)
{
    return bt_gatt_attr_read(conn, attr, buf, len, offset, &is_lost, sizeof(is_lost));
}
static ssize_t read_dist_char(struct bt_conn *conn,
                                 const struct bt_gatt_attr *attr,
                                 void *buf, uint16_t len, uint16_t offset)
{
    return bt_gatt_attr_read(conn, attr, buf, len, offset, &lf_distance, sizeof(lf_distance));
}

static struct bt_le_scan_param scan_param = {
	.type     = BT_LE_SCAN_TYPE_ACTIVE,
	.interval = BT_GAP_SCAN_FAST_INTERVAL,
	.window   = BT_GAP_SCAN_FAST_WINDOW,
	.options  = BT_LE_SCAN_OPT_NONE,
	.timeout  = 0,
};

static struct bt_scan_init_param scan_init = {
	.connect_if_match = 0,
	.scan_param = &scan_param,
	.conn_param = NULL
};

static uint32_t scanner_random_share;

static struct bt_le_ext_adv *adv;
static void adv_work_handle(struct k_work *item);
static K_WORK_DEFINE(adv_work, adv_work_handle);
static void adv_update_data(void);
static uint32_t scanner_addr_to_random_share(const bt_addr_t *p_scanner_addr);
static uint32_t get_id_addr_random_share(void);

static struct bt_scan_manufacturer_data scan_mfg_data = {
	.data = (unsigned char *)&mfg_data,
	.data_len = sizeof(mfg_data.company_code) + sizeof(mfg_data.support_dm_code),
};

static bool data_cb(struct bt_data *data, void *user_data)
{
	struct adv_mfg_data *recv_mfg_data;
	struct dm_request req;

	switch (data->type) {
	case BT_DATA_MANUFACTURER_DATA:
		if (sizeof(struct adv_mfg_data) == data->data_len) {
			recv_mfg_data = (struct adv_mfg_data *)data->data;

			bt_addr_le_copy(&req.bt_addr, user_data);
			req.role = DM_ROLE_INITIATOR;
			req.ranging_mode = peer_ranging_mode_get();
			req.rng_seed = sys_le32_to_cpu(recv_mfg_data->rng_seed);
			req.start_delay_us = 0;
			req.extra_window_time_us = 0;

			dm_request_add(&req);
		}
		return false;
	default:
		return true;
	}
}

static uint32_t get_id_addr_random_share(void)
{
	bt_addr_le_t addrs[CONFIG_BT_ID_MAX];
	size_t count = CONFIG_BT_ID_MAX;

	bt_id_get(addrs, &count);

	__ASSERT(count == 1, "The sample assumes a single ID addr");

	return scanner_addr_to_random_share(&addrs[0].a);
}

static uint32_t scanner_addr_to_random_share(const bt_addr_t *p_scanner_addr)
{
	return (p_scanner_addr->val[0] | p_scanner_addr->val[1] << 8 |
		p_scanner_addr->val[2] << 16 | p_scanner_addr->val[3] << 24) +
	       (p_scanner_addr->val[4] | p_scanner_addr->val[5] << 8);
}

static void scan_filter_match(struct bt_scan_device_info *device_info,
			      struct bt_scan_filter_match *filter_match,
			      bool connectable)
{
	bt_addr_le_t addr;
	bt_addr_le_copy(&addr, device_info->recv_info->addr);
	peer_supported_add(device_info->recv_info->addr);
	bt_data_parse(device_info->adv_data, data_cb, &addr);
}

BT_SCAN_CB_INIT(scan_cb, scan_filter_match, NULL, NULL, NULL);

static void adv_scanned_cb(struct bt_le_ext_adv *adv,
			struct bt_le_ext_adv_scanned_info *info)
{
	struct dm_request req;

	if (peer_supported_test(info->addr)) {
		bt_addr_le_copy(&req.bt_addr, info->addr);
		req.role = DM_ROLE_REFLECTOR;
		req.ranging_mode = peer_ranging_mode_get();
		req.rng_seed = peer_rng_seed_get();
		req.start_delay_us = 0;
		req.extra_window_time_us = 0;

		dm_request_add(&req);
		adv_update_data();
	}
}

const static struct bt_le_ext_adv_cb adv_cb = {
	.scanned = adv_scanned_cb,
};

static void adv_update_data(void)
{
	int err;

	if (!adv) {
		return;
	}
	mfg_data.rng_seed = peer_rng_seed_prepare();
	err = bt_le_ext_adv_set_data(adv, ad, ARRAY_SIZE(ad), sd, ARRAY_SIZE(sd));
	if (err) {
		projectPrint_printfViaUART("Failed setting adv data (err ", "%s");
		projectPrint_printfViaUART(&err, "%d");
		projectPrint_printfViaUART(")\n", "%s");
	}
}

static int adv_start(void)
{
	int err;
	struct bt_le_ext_adv_start_param ext_adv_start_param = {0};
	//if already advertissing will try to extending it or delete it
	if (adv) {
		err = bt_le_ext_adv_stop(adv);
		if (err) {
			projectPrint_printfViaUART("Failed to stop extended advertising (err ", "%s");
			projectPrint_printfViaUART(&err, "%d");
			projectPrint_printfViaUART(")\n", "%s");
			return err;
		}
			err = bt_le_ext_adv_delete(adv);
		if (err) {
			projectPrint_printfViaUART("Failed to delete advertising set (err ", "%s");
			projectPrint_printfViaUART(&err, "%d");
			projectPrint_printfViaUART(")\n", "%s");
			return err;
		}
	}

	err = bt_le_ext_adv_create(adv_param, &adv_cb, &adv);
	if (err) {
		projectPrint_printfViaUART("Failed to create advertising set (err ", "%s");
		projectPrint_printfViaUART(&err, "%d");
		projectPrint_printfViaUART(")\n", "%s");
		return err;
	}
	projectPrint_printfViaUART("adv created\n", "%s");

	err = bt_le_ext_adv_set_data(adv, ad, ARRAY_SIZE(ad), sd, ARRAY_SIZE(sd));
	if (err) {
		projectPrint_printfViaUART("Failed setting adv data (err ", "%s");
		projectPrint_printfViaUART(&err, "%d");
		projectPrint_printfViaUART(")\n", "%s");
		return err;
	}
	projectPrint_printfViaUART("adv set\n", "%s");

	err = bt_le_ext_adv_start(adv, &ext_adv_start_param);
	if (err) {
		projectPrint_printfViaUART("Failed to start extended advertising  (err ", "%s");
		projectPrint_printfViaUART(&err, "%d");
		projectPrint_printfViaUART(")\n", "%s");
		return err;
	}
	projectPrint_printfViaUART("adv start\n", "%s");

	return err;
}

static int scan_start(void)
{
	int err;

	bt_scan_init(&scan_init);
	bt_scan_cb_register(&scan_cb);

	err = bt_scan_filter_add(BT_SCAN_FILTER_TYPE_MANUFACTURER_DATA, &scan_mfg_data);
	if (err) {
		projectPrint_printfViaUART("Scanning filters cannot be set (err ", "%s");
		projectPrint_printfViaUART(&err, "%d");
		projectPrint_printfViaUART(")\n", "%s");
		return err;
	}

	err = bt_scan_filter_enable(BT_SCAN_MANUFACTURER_DATA_FILTER, false);
	if (err) {
		projectPrint_printfViaUART("Filters cannot be turned on (err ", "%s");
		projectPrint_printfViaUART(&err, "%d");
		projectPrint_printfViaUART(")\n", "%s");
		return err;
	}

	scanner_random_share = get_id_addr_random_share();

	err = bt_scan_start(BT_SCAN_TYPE_SCAN_ACTIVE);
	if (err) {
		projectPrint_printfViaUART("Scanning failed to start (err ", "%s");
		projectPrint_printfViaUART(&err, "%d");
		projectPrint_printfViaUART(")\n", "%s");
		return err;
	}

	return err;
}

static void adv_work_handle(struct k_work *item)
{
	adv_start();
}

static void connected(struct bt_conn *conn, uint8_t conn_err)
{
	adv_param = &adv_param_noconn;
	projectPrint_printfViaUART("in conn : ", "%s");
	projectPrint_printfViaUART(conn, "%d");
	projectPrint_printfViaUART("\n", "%s");
	k_work_submit(&adv_work);

	dk_set_led_on(CON_STATUS_LED);
}

static void disconnected(struct bt_conn *conn, uint8_t reason)
{
	adv_param = &adv_param_conn;
	k_work_submit(&adv_work);

	dk_set_led_off(CON_STATUS_LED);
}

BT_CONN_CB_DEFINE(conn_callbacks) = {
	.connected = connected,
	.disconnected = disconnected,
};

static int bt_sync_init(void)
{
	/* Synchronisation is based on advertising and scanning modes.
	 * It occurs when SCAN_REQ and SCAN_RESP packets are exchanged.
	 */
	int err;
	//fill manufacturer data
	mfg_data.company_code = sys_cpu_to_le16(CONFIG_BT_COMPANY_ID_NORDIC);
	mfg_data.support_dm_code = sys_cpu_to_le32(SUPPORT_DM_CODE);
	mfg_data.rng_seed = sys_cpu_to_le32(RNG_SEED);

	err = adv_start();
	if (err) {
		projectPrint_printfViaUART("Failed to start advertising (err ", "%s");
		projectPrint_printfViaUART(&err, "%d");
		projectPrint_printfViaUART(")\n", "%s");
		return err;
	}
	projectPrint_printfViaUART("start advertising\n", "%s");
	err = scan_start();
	if (err) {
		projectPrint_printfViaUART("Failed to start scanning (", "%s");
		projectPrint_printfViaUART(&err, "%d");
		projectPrint_printfViaUART(")\n", "%s");
	}		
	projectPrint_printfViaUART("start scanning\n", "%s");
	
	return err;
}

static void data_ready(struct dm_result *result)
{
	if (result->status) {
		peer_update(result);
	}
}

static struct dm_cb dm_cb = {
	.data_ready = data_ready,
};

bool firmware_init(void) 
{
	int err;
	struct dm_init_param init_param;

	dm_handling_initDistanceMesurementHandling();

	err = dk_leds_init();
	if (err) {
		projectPrint_printfViaUART("LEDs init failed\n", "%s");
		return false;
	}
	
	err = peer_init();
	if (err) {
		projectPrint_printfViaUART("Peer init failed\n", "%s");
		return false;
	}

	init_param.cb = &dm_cb;

	err = dm_init(&init_param);
	if (err) {
		projectPrint_printfViaUART("Distance measurement init failed\n", "%s");
		return false;
	}

	err = service_ddfs_init();
	if (err) {
		projectPrint_printfViaUART("DDF Service init failed\n", "%s");
		return false;
	}

	err = bt_enable(NULL);
	if (err) {
		projectPrint_printfViaUART("Bluetooth init failed\n", "%s");
		return false;
	}

	err = bt_sync_init();
	if (err) {
		projectPrint_printfViaUART("Synchronisation init failed\n", "%s");
		return false;
	}

	return true;
}

int main(void)
{
	uint32_t blink_status = 0;
	
	projectPrint_printfViaUART(DEVICE_NAME, "%s");
	projectPrint_printfViaUART(" starting...\n", "%s");
	//project init
	if ( !firmware_init() ) {
		projectPrint_printfViaUART("init failled\n", "%s");
		return 0;
	}
	projectPrint_printfViaUART("init sucessful\n", "%s");

	for (;;) {
		dk_set_led(RUN_STATUS_LED, (++blink_status) % 2);
		k_sleep(K_MSEC(RUN_LED_BLINK_INTERVAL));
		dm_handling_processMesurement(&is_lost, &lf_distance);
	}
}
```

## src/distance_measurement_handling.c
```c
#include <zephyr/kernel.h>
#include <zephyr/device.h>
#include <zephyr/drivers/uart.h>

#include <inttypes.h>
#include <string.h>
#include "time.h"
#include "projectPrint.h"
#include "distance_measurement_handling.h"
/*--------------macro definition---------------*/
#define MAX_NUMBER_Of_MEASUREMENT 64
/*------------variable declaration-------------*/
static uint16_t s_ui16_measurementArrayIterator = 0;
static double s_tlf_measurementArray[MAX_NUMBER_Of_MEASUREMENT] = {0};
static uint32_t s_ui32_startTime = 0;
static double s_lf_distance = 0;
static bool s_is_lostPrevious;
/*-------------function prototype--------------*/
static void dm_handling_sortData(void);
/*----------function implementation------------*/
/*
* description : This function is used initialize the distance measurment file and should be called in the program initialization. 
* parameters :  none.
* retrun     :  none.
*/
void dm_handling_initDistanceMesurementHandling(void)
{
    s_ui32_startTime = time_now();
    s_is_lostPrevious = false;
    return;
}
/*
* description : This function is used to calculate the average of the last measurement if condition are met. The conditions 
*               being either the maximum number of measurement was taken or a certain amount of time as passed (those numbers 
*               are arbitrairy and can be change at will). This function will remove the 10% botom and top outlier from the 
*               data and then average them. If the fileterd distance is above 2.5 meters will set the new distancethe and 
*               boolean passed as parameters to true, false otherwise.   
* parameters :  p_pis_lost : pointer bollean
* retrun     :  none.
*/
void dm_handling_processMesurement(bool *p_pis_lost, double *p_plf_distance)
{
    uint32_t ui32_actualTime = time_now();
    uint32_t ui32_deltaTime = ui32_actualTime - s_ui32_startTime;
    if ( ( ui32_deltaTime >= 50000) || s_ui16_measurementArrayIterator >= MAX_NUMBER_Of_MEASUREMENT) {
        s_ui32_startTime = ui32_actualTime;
        //sort data from lowest to highest
        dm_handling_sortData();
        //get index of the bottom and top 10% to remove
        uint8_t ui8_indexLow10Percent = (s_ui16_measurementArrayIterator + 1) / 10;
        uint8_t ui8_indexHigh10Percent = s_ui16_measurementArrayIterator - ui8_indexLow10Percent;
        //get filtered distance
        uint8_t ui8_filteredDataIterator;
        double lf_distance = 0;
        for ( ui8_filteredDataIterator = ui8_indexLow10Percent ; ui8_filteredDataIterator <= ui8_indexHigh10Percent; ++ui8_filteredDataIterator) {
            lf_distance += s_tlf_measurementArray[ui8_filteredDataIterator];
        }
        //reset data array and iterator
        memset(s_tlf_measurementArray, 0, MAX_NUMBER_Of_MEASUREMENT * sizeof(double));
        s_ui16_measurementArrayIterator = 0;
        //calculate distance average
        s_lf_distance = lf_distance / ui8_filteredDataIterator;
        projectPrint_printfViaUART("distance = ", "%s");
        projectPrint_printfViaUART(&s_lf_distance, "%f");
        projectPrint_printfViaUART("\n", "%s");
        //check if data isn't valid i.e. communcation didn't occur between the cards (!!! not == 0 because double value)
        if (s_lf_distance < 0.01) return;
        //check if distance is above 2.5 meters
        bool is_lostActual = (s_lf_distance > 2.5) ? true : false; 
        //check if reading is the same as the previous one if so will update param boolean and distance
        if (is_lostActual == s_is_lostPrevious) {
            *p_pis_lost = is_lostActual;
            *p_plf_distance = s_lf_distance;
        }
        //save distance check
        s_is_lostPrevious = is_lostActual;
    } else {
        //nothing not enough data 
    }
    return;
}
/*
* description : This function is used to add a value passed as parameter in the data array. It will also increment the
*               array index. 
* parameters :  p_lf_data : double value, value to add to the array
* retrun     :  none.
*/
void dm_handling_addData(double p_lf_data)
{
    s_tlf_measurementArray[s_ui16_measurementArrayIterator] = p_lf_data;
    s_ui16_measurementArrayIterator ++;
    return;
}
/*---------------static function---------------*/
/*
* description : This function is used to sort the data array. This is a bubble sort since the sample sorted is small. 
* parameters :  none.
* retrun     :  none.
*/
static void dm_handling_sortData(void)
{
    for (uint16_t i = 0; i < s_ui16_measurementArrayIterator - 1; ++i) {
        for (uint16_t j = 0; j < s_ui16_measurementArrayIterator - i - 1; ++j) {
            if (s_tlf_measurementArray[j] > s_tlf_measurementArray[j + 1]) {
                // Swap the values
                float temp = s_tlf_measurementArray[j];
                s_tlf_measurementArray[j] = s_tlf_measurementArray[j + 1];
                s_tlf_measurementArray[j + 1] = temp;
            }
        }
    }
    return;
}
/*-----------------end of file-----------------*/
```

## src/distance_measurement_handling.h
```c
#ifndef _DM_HANDLING_H
#define _DM_HANDLING_H

void dm_handling_initDistanceMesurementHandling(void);
void dm_handling_processMesurement(bool *p_pis_lost, double *p_plf_distance);
void dm_handling_addData(double p_lf_data);

#endif
```

## src/peer.c
```c
/*
 * Copyright (c) 2021 Nordic Semiconductor ASA
 *
 * SPDX-License-Identifier: LicenseRef-Nordic-5-Clause
 */

#include <zephyr/kernel.h>
#include <zephyr/random/random.h>

#include <math.h>

#include "peer.h"
#include "pwm_led.h"
#include "service.h"

#include "projectPrint.h"
#include "distance_measurement_handling.h"

#define PEER_MAX                8   /* Maximum number of tracked peer devices. */

#define STACKSIZE               1024
#define PEER_THREAD_PRIORITY    K_LOWEST_APPLICATION_THREAD_PRIO

#define PEER_TIMEOUT_STEP_MS    500
#define PEER_TIMEOUT_INIT_MS    10000

#define DISTANCE_MAX_LED        50   /* from 0 to DISTANCE_MAX_LED [decimeter] -
				      * the distance range which is indicated by the PWM LED
				      */
#define DEFAULT_RANGING_MODE    DM_RANGING_MODE_MCPD

static void timeout_handler(struct k_timer *timer_id);
static K_TIMER_DEFINE(timer, timeout_handler, NULL);

struct peer_entry {
	sys_snode_t node;
	bt_addr_le_t bt_addr;
	struct dm_result result;
	uint16_t timeout_ms;
};

static struct peer_entry *closest_peer;
static uint32_t rng_seed;
static enum dm_ranging_mode ranging_mode = DEFAULT_RANGING_MODE;

K_MSGQ_DEFINE(result_msgq, sizeof(struct dm_result), 16, 4);

static K_HEAP_DEFINE(peer_heap, PEER_MAX * sizeof(struct peer_entry));
static sys_slist_t peer_list = SYS_SLIST_STATIC_INIT(&peer_list);

static K_MUTEX_DEFINE(list_mtx);

static void list_lock(void)
{
	k_mutex_lock(&list_mtx, K_FOREVER);
}

static void list_unlock(void)
{
	k_mutex_unlock(&list_mtx);
}

static struct peer_entry *mcpd_min_peer_result(struct peer_entry *a, struct peer_entry *b)
{
	if (!a && !b) {
		return NULL;
	} else if (!a && b) {
		return b->result.ranging_mode == DM_RANGING_MODE_MCPD ? b : NULL;
	} else if (a && !b) {
		return a->result.ranging_mode == DM_RANGING_MODE_MCPD ? a : NULL;
	} else if (a->result.ranging_mode == DM_RANGING_MODE_RTT &&
		   b->result.ranging_mode == DM_RANGING_MODE_RTT) {
		return NULL;
	} else if (a->result.ranging_mode == DM_RANGING_MODE_RTT &&
		   b->result.ranging_mode == DM_RANGING_MODE_MCPD) {
		return b;
	} else if (a->result.ranging_mode == DM_RANGING_MODE_MCPD &&
		   b->result.ranging_mode == DM_RANGING_MODE_RTT){
		return a;
	}

#ifdef CONFIG_DM_HIGH_PRECISION_CALC
	float dist_a = !isnan(a->result.dist_estimates.mcpd.high_precision) ?
		  a->result.dist_estimates.mcpd.high_precision : a->result.dist_estimates.mcpd.best;
	float dist_b = !isnan(b->result.dist_estimates.mcpd.high_precision) ?
		  b->result.dist_estimates.mcpd.high_precision : b->result.dist_estimates.mcpd.best;

	if (dist_a < dist_b) {
		return a;
	}
	return b;
#else
	if (a->result.dist_estimates.mcpd.best < b->result.dist_estimates.mcpd.best) {
		return a;
	}
	return b;
#endif
}

static struct peer_entry *peer_find_closest(void)
{
	struct peer_entry *closest_peer, *item;
	sys_snode_t *node, *tmp;

	closest_peer = SYS_SLIST_PEEK_HEAD_CONTAINER(&peer_list, closest_peer, node);
	if (!closest_peer) {
		return NULL;
	}

	SYS_SLIST_FOR_EACH_NODE_SAFE(&peer_list, node, tmp) {
		item = CONTAINER_OF(node, struct peer_entry, node);
		closest_peer = mcpd_min_peer_result(closest_peer, item);
	}

	return closest_peer;
}

struct peer_entry *peer_find(const bt_addr_le_t *peer)
{
	if (!peer) {
		return NULL;
	}

	sys_snode_t *node, *tmp;
	struct peer_entry *item;

	SYS_SLIST_FOR_EACH_NODE_SAFE(&peer_list, node, tmp) {
		item = CONTAINER_OF(node, struct peer_entry, node);
		if (bt_addr_le_cmp(&item->bt_addr, peer) == 0) {
			return item;
		}
	}

	return NULL;
}

static void ble_notification(const struct peer_entry *peer)
{
	//projectPrint_printfViaUART("in ble notif\n", "%s");
	service_distance_measurement_update(&peer->bt_addr, &peer->result);
}

static void led_notification(const struct peer_entry *peer)
{
	if (!peer) {
		pwm_led_set(0);
		return;
	}

	float res;

	if (peer->result.ranging_mode == DM_RANGING_MODE_RTT) {
		res = peer->result.dist_estimates.rtt.rtt;
	} else {
#ifdef CONFIG_DM_HIGH_PRECISION_CALC
		res = peer->result.dist_estimates.mcpd.high_precision;
		res = isnan(res) ? peer->result.dist_estimates.mcpd.best : res;
#else
		res = peer->result.dist_estimates.mcpd.best;
#endif
	}

	res = (res < 0 ? 0 : res) * 10;
	if (res > DISTANCE_MAX_LED) {
		pwm_led_set(0);
	} else {
		pwm_led_set((UINT16_MAX/DISTANCE_MAX_LED * res * (-1)) + UINT16_MAX);
	}
}

static void print_result(struct dm_result *result)
{
	if (!result) {
		return;
	}

	char *qualityList[DM_QUALITY_NONE + 1] = {"ok", "poor", "do not use", "crc fail", "none"};
	char addr[BT_ADDR_LE_STR_LEN];
	int status = (int)result->status;

	bt_addr_le_to_str(&result->bt_addr, addr, sizeof(addr));

	projectPrint_printfViaUART("Addr: ", "%s");
	projectPrint_printfViaUART(addr, "%s");
	projectPrint_printfViaUART("\nQuality: ", "%s");
	projectPrint_printfViaUART(qualityList[(int)result->quality], "%s");
	projectPrint_printfViaUART("\nStatus: ", "%s");
	projectPrint_printfViaUART(&status, "%d");
	projectPrint_printfViaUART("\n", "%s");
	if (result->ranging_mode == DM_RANGING_MODE_RTT) {
		projectPrint_printfViaUART("rtt : ", "%s");
		projectPrint_printfViaUART(&result->dist_estimates.rtt.rtt, "%f");
		projectPrint_printfViaUART("\n", "%d");
	} else {
#ifdef CONFIG_DM_HIGH_PRECISION_CALC
		printk("mcpd: high_precision=%.2f ifft=%.2f phase_slope=%.2f "
			"rssi_openspace=%.2f best=%.2f\n",
			(double)result->dist_estimates.mcpd.high_precision,
			(double)result->dist_estimates.mcpd.ifft,
			(double)result->dist_estimates.mcpd.phase_slope,
			(double)result->dist_estimates.mcpd.rssi_openspace,
			(double)result->dist_estimates.mcpd.best);
#else
		projectPrint_printfViaUART("best : ", "%s");
		projectPrint_printfViaUART(&result->dist_estimates.mcpd.best, "%f");
		projectPrint_printfViaUART(" ;ifft : ", "%s");
		projectPrint_printfViaUART(&result->dist_estimates.mcpd.ifft, "%f");
		projectPrint_printfViaUART(" ;phase : ", "%s");
		projectPrint_printfViaUART(&result->dist_estimates.mcpd.phase_slope, "%f");
		projectPrint_printfViaUART(" ;rssi : ", "%s");
		projectPrint_printfViaUART(&result->dist_estimates.mcpd.rssi_openspace, "%f");
		projectPrint_printfViaUART("\n", "%s");
#endif
	}
}

static void timeout_handler(struct k_timer *timer_id)
{
	sys_snode_t *node, *tmp;
	struct peer_entry *item;

	SYS_SLIST_FOR_EACH_NODE_SAFE(&peer_list, node, tmp) {
		item = CONTAINER_OF(node, struct peer_entry, node);
		if (item->timeout_ms > PEER_TIMEOUT_STEP_MS) {
			item->timeout_ms -= PEER_TIMEOUT_STEP_MS;
		} else {
			sys_slist_remove(&peer_list, NULL, node);
			k_heap_free(&peer_heap, item);
			closest_peer = peer_find_closest();

			led_notification(closest_peer);
		}
	}
}

static void peer_thread(void)
{
	struct dm_result result;

	while (1) {
		if (k_msgq_get(&result_msgq, &result, K_FOREVER) == 0) {
			struct peer_entry *peer;

			peer = peer_find(&result.bt_addr);
			if (!peer) {
				continue;
			}

			memcpy(&peer->result, &result, sizeof(peer->result));
			peer->timeout_ms = PEER_TIMEOUT_INIT_MS;
			//print_result(&peer->result);

			closest_peer = mcpd_min_peer_result(closest_peer, peer);

			led_notification(closest_peer);
			ble_notification(peer);
		}
	}
}

void peer_ranging_mode_set(enum dm_ranging_mode mode)
{
	ranging_mode = mode;
}

enum dm_ranging_mode peer_ranging_mode_get(void)
{
	return ranging_mode;
}

uint32_t peer_rng_seed_prepare(void)
{
	rng_seed = sys_rand32_get();
	return rng_seed;
}

uint32_t peer_rng_seed_get(void)
{
	return rng_seed;
}

bool peer_supported_test(const bt_addr_le_t *peer)
{
	sys_snode_t *node, *tmp;
	struct peer_entry *item;

	SYS_SLIST_FOR_EACH_NODE_SAFE(&peer_list, node, tmp) {
		item = CONTAINER_OF(node, struct peer_entry, node);
		if (bt_addr_le_cmp(&item->bt_addr, peer) == 0) {
			return true;
		}
	}

	return false;
}

int peer_supported_add(const bt_addr_le_t *peer)
{
	struct peer_entry *item;

	if (peer_supported_test(peer)) {
		return 0;
	}

	item = k_heap_alloc(&peer_heap, sizeof(struct peer_entry), K_NO_WAIT);
	if (!item) {
		return -ENOMEM;
	}

	item->timeout_ms = PEER_TIMEOUT_INIT_MS;
	bt_addr_le_copy(&item->bt_addr, peer);
	list_lock();
	sys_slist_append(&peer_list, &item->node);
	list_unlock();

	return 0;
}

void peer_update(struct dm_result *result)
{
	//projectPrint_printfViaUART("in peer up\n", "%s");
	k_msgq_put(&result_msgq, result, K_NO_WAIT);
}

int peer_init(void)
{
	int err;

	k_timer_start(&timer, K_NO_WAIT, K_MSEC(PEER_TIMEOUT_STEP_MS));

	err = pwm_led_init();
	if (err) {
		//printk("PWM LED init failed (err %d)\n", err);
		return err;
	}

	return 0;
}

K_THREAD_DEFINE(peer_consumer_thred_id, STACKSIZE, peer_thread,
		NULL, NULL, NULL, PEER_THREAD_PRIORITY, 0, 0);
```

## src/projectPrint.c
```c
#include <zephyr/kernel.h>
#include <zephyr/device.h>
#include <zephyr/drivers/uart.h>

#include <string.h>
#include "projectPrint.h"

/* change this to any other UART peripheral if desired */
#define UART_DEVICE_NODE DT_CHOSEN(zephyr_shell_uart)

/* queue to store up to 10 messages (aligned to 4-byte boundary) */
K_MSGQ_DEFINE(uart_msgq, MSG_SIZE, 10, 4);

static const struct device *const uart_dev = DEVICE_DT_GET(UART_DEVICE_NODE);

/*used to received data via serial : not used as of the end of the project but kept just in case 
//receive buffer used in UART ISR callback
static char rx_buf[MSG_SIZE];
static int rx_buf_pos;

/*-------------function prototype--------------*/
/*used to received data via serial : not used as of the end of the project but kept just in case 
static void serial_cb(const struct device *dev, void *user_data);*/
/*----------function implementation------------*/
/*
 * Print a null-terminated string character by character to the UART interface
 */
void projectPrint_printfViaUART(void *buf, const char *p_c_format)
{
	char data_to_send[MSG_SIZE];
	//compare p_c_format to known format to convert them to a string
	if (strcmp(p_c_format,"%s") == 0) {
		strcpy( data_to_send, (const char*)buf );
	} else if (strcmp((const char *)p_c_format,"%d") == 0) {
		snprintf(data_to_send, MSG_SIZE, "%d", *(int *)buf);
	} else if (strcmp((const char *)p_c_format,"%f") == 0){
		snprintf(data_to_send, MSG_SIZE, "%f", *(double*)buf);
	}
	//get string lenght
	int msg_len = strlen(data_to_send);
	//send data byte by byte
	for (int i = 0; i < msg_len; i++) {
		uart_poll_out(uart_dev, data_to_send[i]);
	}
}
/*used to received data via serial : not used as of the end of the project but kept just in case 
int projectPrint_init(void)
{
    if (!device_is_ready(uart_dev)) {
		printk("UART device not found!");
		return 0;
	}

	//configure interrupt and callback to receive data
	int ret = uart_irq_callback_user_data_set(uart_dev, serial_cb, NULL);

	if (ret < 0) {
		if (ret == -ENOTSUP) {
			printk("Interrupt-driven UART API support not enabled\n");
		} else if (ret == -ENOSYS) {
			printk("UART device does not support interrupt-driven API\n");
		} else {
			printk("Error setting UART callback: %d\n", ret);
		}
		return 0;
	}
	uart_irq_rx_enable(uart_dev);
    return 1;
}*/
/*used to received data via serial : not used as of the end of the project but kept just in case 
int projectPrint_getMsg(void *data)
{
    return k_msgq_get(&uart_msgq, &data, K_FOREVER);
}*/
/*---------------static function---------------*/
/*used to received data via serial : not used as of the end of the project but kept just in case
/*
 * Read characters from UART until line end is detected. Afterwards push the
 * data to the message queue.
 
static void serial_cb(const struct device *dev, void *user_data)
{
	uint8_t c;

	if (!uart_irq_update(uart_dev)) {
		return;
	}

	if (!uart_irq_rx_ready(uart_dev)) {
		return;
	}

	//read until FIFO empty
	while (uart_fifo_read(uart_dev, &c, 1) == 1) {
		if ((c == '\n' || c == '\r') && rx_buf_pos > 0) {
			//terminate string
			rx_buf[rx_buf_pos] = '\0';

			//if queue is full, message is silently dropped
			k_msgq_put(&uart_msgq, &rx_buf, K_NO_WAIT);

			//reset the buffer (it was copied to the msgq)
			rx_buf_pos = 0;
		} else if (rx_buf_pos < (sizeof(rx_buf) - 1)) {
			rx_buf[rx_buf_pos++] = c;
		}
		//else: characters beyond buffer size are dropped
	}
}*/
//end of file
```

## src/projectPrint.h
```c
#ifndef _PROJECTPRINT_H
#define _PROJECTPRINT_H

#define MSG_SIZE 128

//functions prototypes
void projectPrint_printfViaUART(void *buf, const char *p_c_format);
int projectPrint_init(void);
int projectPrint_getMsg(void *data);


#endif
```

## src/service.c
```c
/*
 * Copyright (c) 2021 Nordic Semiconductor ASA
 *
 * SPDX-License-Identifier: LicenseRef-Nordic-5-Clause
 */

#include <zephyr/kernel.h>
#include <bluetooth/services/ddfs.h>
#include <zephyr/random/random.h>
#include <dm.h>

#include "service.h"
#include "peer.h"
#include "projectPrint.h"
#include "distance_measurement_handling.h"


static int dm_ranging_mode_set(uint8_t mode)
{
	if (mode == BT_DDFS_DM_RANGING_MODE_RTT) {
		peer_ranging_mode_set(DM_RANGING_MODE_RTT);
	} else if (mode == BT_DDFS_DM_RANGING_MODE_MCPD) {
		peer_ranging_mode_set(DM_RANGING_MODE_MCPD);
	} else {
		return -1;
	}

	//printk("DM set ranging mode to %s\n", mode == BT_DDFS_DM_RANGING_MODE_RTT ? "RTT" : "MCPD");
	return 0;
}

static int dm_config_read(struct bt_ddfs_dm_config *config)
{
	enum dm_ranging_mode ranging_mode;

	if (!config) {
		return -1;
	}

	ranging_mode = peer_ranging_mode_get();
	if (ranging_mode == DM_RANGING_MODE_RTT) {
		config->mode = BT_DDFS_DM_RANGING_MODE_RTT;
	} else if (ranging_mode == DM_RANGING_MODE_MCPD) {
		config->mode = BT_DDFS_DM_RANGING_MODE_MCPD;
	} else {
		return -1;
	}

	if (IS_ENABLED(CONFIG_DM_HIGH_PRECISION_CALC)) {
		config->high_precision = true;
	} else {
		config->high_precision = false;
	}

	return 0;
}

static uint16_t meter_to_decimeter(float value)
{
	float val;
	val = (value < 0 ? 0 : value) * 10;

	return val < UINT16_MAX ? (uint16_t)val : UINT16_MAX;
}

void service_distance_measurement_update(const bt_addr_le_t *addr, const struct dm_result *result)
{
	struct bt_ddfs_distance_measurement measurement;
	int err;

	if (!addr || !result) {
		return;
	}

	if (result->quality == DM_QUALITY_OK) {
		measurement.quality = BT_DDFS_QUALITY_OK;
	} else if (result->quality == DM_QUALITY_POOR) {
		measurement.quality = BT_DDFS_QUALITY_POOR;
	} else if (result->quality == DM_QUALITY_DO_NOT_USE) {
		measurement.quality = BT_DDFS_QUALITY_DO_NOT_USE;
	} else if (result->quality == DM_QUALITY_CRC_FAIL) {
		measurement.quality = BT_DDFS_QUALITY_DO_NOT_USE;
	} else {
		measurement.quality = BT_DDFS_QUALITY_NONE;
	}

	if (result->ranging_mode == DM_RANGING_MODE_RTT) {
    measurement.ranging_mode = BT_DDFS_DM_RANGING_MODE_RTT;
    measurement.dist_estimates.rtt.rtt =
            meter_to_decimeter(result->dist_estimates.rtt.rtt);
} else {
    measurement.ranging_mode = BT_DDFS_DM_RANGING_MODE_MCPD;

    double lf_ifft = (double)result->dist_estimates.mcpd.ifft;
    dm_handling_addData(lf_ifft);
    measurement.dist_estimates.mcpd.ifft =
            meter_to_decimeter(result->dist_estimates.mcpd.ifft);
    measurement.dist_estimates.mcpd.phase_slope =
            meter_to_decimeter(result->dist_estimates.mcpd.phase_slope);
    measurement.dist_estimates.mcpd.rssi_openspace =
            meter_to_decimeter(result->dist_estimates.mcpd.rssi_openspace);
    measurement.dist_estimates.mcpd.best =
            meter_to_decimeter(result->dist_estimates.mcpd.best);
#ifdef CONFIG_DM_HIGH_PRECISION_CALC
    measurement.dist_estimates.mcpd.high_precision =
            meter_to_decimeter(result->dist_estimates.mcpd.high_precision);
#endif
}

	bt_addr_le_copy(&measurement.bt_addr, addr);
	
	err = bt_ddfs_distance_measurement_notify(NULL, &measurement);
	if (err && (err != -EACCES) && (err != -ENOTCONN)) {
		//printk("Failed to send distance measurement (err %d)\n", err);
	}
}

void service_azimuth_elevation_simulation(void)
{
	int err;
	//projectPrint_printfViaUART("in serv", "%s");

	uint32_t rand = sys_rand32_get();
	struct bt_ddfs_elevation_measurement elevation;
	struct bt_ddfs_azimuth_measurement azimuth;
	const bt_addr_le_t bt_addr = {
		.type = BT_ADDR_LE_RANDOM,
		.a.val = {0xFF, 0xEE, 0xDD, 0xCC, 0xBB, 0xAA},
	};

	elevation.quality = rand % (BT_DDFS_QUALITY_DO_NOT_USE + 1);
	elevation.value	= -90 + rand % 91;
	bt_addr_le_copy(&elevation.bt_addr, &bt_addr);

	azimuth.quality = rand % (BT_DDFS_QUALITY_DO_NOT_USE + 1);
	azimuth.value = rand % 360;
	bt_addr_le_copy(&azimuth.bt_addr, &bt_addr);

	err = bt_ddfs_elevation_measurement_notify(NULL, &elevation);
	if (err && (err != -EACCES) && (err != -ENOTCONN)) {
		//printk("Failed to send elevation measurement (err %d)\n", err);
	}

	err = bt_ddfs_azimuth_measurement_notify(NULL, &azimuth);
	if (err && (err != -EACCES) && (err != -ENOTCONN)) {
		//printk("Failed to send azimuth measurement (err %d)\n", err);
	}
	//projectPrint_printfViaUART(azimuth.value, "%d");
}

static const struct bt_ddfs_cb cb = {
	.dm_ranging_mode_set = dm_ranging_mode_set,
	.dm_config_read = dm_config_read,
	.am_notification_config_changed = NULL,
	.dm_notification_config_changed = NULL,
	.em_notification_config_changed = NULL
};

int service_ddfs_init(void)
{
	struct bt_ddfs_init_params ddfs_init = {0};

	//ddfs_init.dm_features.ranging_mode_rtt = 1;
	ddfs_init.dm_features.ranging_mode_mcpd = 1;
	ddfs_init.cb = &cb;

	return bt_ddfs_init(&ddfs_init);
}
```
